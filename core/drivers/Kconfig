## core/drivers/Kconfig
```kconfig
menu "Drivers"

config DEV_UART
       tristate "Enable UART driver"
       depends on AARCH64 || x86
       default y

config DEV_VGA
       bool "Enable VGA driver"
       depends on x86
       default y
       
config EARLY_OUTPUT
       bool "Enable early output"
       depends on (DEV_UART&&(AARCH64))||(x86&&(DEV_UART||DEV_VGA))
       default n

config EARLY_CPU_MHZ
       int "CPU frequency (MHz)"
       depends on EARLY_OUTPUT&&(AARCH64)
       default 45

config EARLY_UART_BAUDRATE
       int "Early UART baudrate"
       depends on EARLY_OUTPUT&&(AARCH64)
       default 115200

choice
        prompt "Select early UART port"
        default EARLY_UART1
        depends on EARLY_OUTPUT&&(AARCH64)

config EARLY_UART1
       bool "UART1"

config EARLY_UART2
       bool "UART2"

endchoice


config DEV_NO_UARTS
       int
       default "2"
       depends on DEV_UART

choice
       prompt "Select early output device"
       default EARLY_DEV_UART
       depends on EARLY_OUTPUT && (x86||AARCH64)
       
config EARLY_DEV_UART
       bool "UART"
       depends on DEV_UART
       
config EARLY_DEV_VGA
       bool "VGA"
       depends on DEV_VGA
endchoice

config DEV_MEMBLOCK
       tristate "Enable memory block driver"
       default y
endmenu
```

## core/kernel/Kconfig
```kconfig
config EXPERIMENTAL
       bool "Enable experimental features"
       default n

menuconfig DEBUG
	   bool "Debug and profiling support"
	   default y
	   
if DEBUG
config VERBOSE_TRAP
       bool "Dump CPU state when a trap is raised"
       default y
endif

config NO_GCC_OPT
       bool "Disable GCC optimizations"
       default y

config ID_STRING_LENGTH
       int "Max. identifier length (B)"
       default "16"

menu "Hypervisor"

config VOLUNTARY_PREEMPTION
       bool "Enable voluntary preemption support"
       default "n"
       depends on EXPERIMENTAL

config PRTOS_MAX_IPVI
	int 
	default "8"

config KSTACK_KB
       int "Kernel stack size (KB)"
       default "8"

config MAX_NO_VCPUS
       int "Max. number of virtual CPUS per partition"
       default NO_CPUS

config AUDIT_EVENTS
       bool "Enable kernel audit events"
       default y

config PLAN_EXTSYNC
       bool "Enable external synchronisation"
       default "n"

config MASKING_VT_HW_IRQS
       bool "Enable masking virtual hardware interrupts after raised"
       depends on SPARCv8
       default n

endmenu

config NO_CPUS
       int
       default "1"
       depends on !SMP

source "Kconfig.ver"

#if MMU
#source "kernel/mmu/Kconfig"
#endif

source "klibc/Kconfig"

menu "PRTOS executable format (PEF)"

config PEF_COMPRESSION
       bool "Enable PEF compression"
       default "y"

endmenu

source "drivers/Kconfig"
source "objects/Kconfig"
```

## core/kernel/aarch64/Kconfig
```kconfig
mainmenu "PRTOS Configuration"

config AARCH64
        def_bool y

config HWIRQ_PRIO_FBS
        def_bool y

config MMU
        def_bool y

config ARCH_MMU_BYPASS
        depends on !AARCH64
        def_bool n

config MAX_NO_KTHREADS
        int
        default "255"

config VMM_UPDATE_HYPERCALLS
        def_bool y

config NO_HWIRQS
        int
        default "16" if !APIC
        default "1024" if APIC

config TARGET_LITTLE_ENDIAN
        def_bool y

menu "Processor"

choice
        prompt "Board"
        default QEMU
	
config QEMU
        bool "Qemu"
        select SMP_INTERFACE_MPSPEC if SMP

config VMWARE
        bool "VMWare"
        select SMP_INTERFACE_ACPI if SMP

endchoice

config CHIPSET_ICH
        bool
        default n

choice
        prompt "Clock source"
        default TSC_TIMER

config TSC_CLOCK
        bool "TSC"
        depends on !SMP
        select PC_PIT_TIMER

config PC_PIT_CLOCK
        bool "PIT"
        depends on !SMP
        select PC_PIT_TIMER

config HPET_CLOCK
        bool "HPET"
        select HPET
        select HPET_TIMER if !SMP

endchoice

config HPET
        def_bool n

config SMI_DISABLE
        bool "Disable SMI Interrupts (see Help WARNING note)"
        default n
        help
        WARNING:
        This option disables SMI Interrupts to provide deterministic RT behaviour.
        At a cost that disabling SMI may cause harm to your computer.
        Be sure *you know what you are doing* before disabling System Management Interrupts.
        default "0x8086" if VMWARE QEMU

config SMP
        bool "Symmetric multi-processing support"
        default n
        select HPET_CLOCK

config NO_CPUS
        int "Number of CPUs supported"
        default "4"
        depends on SMP

if SMP
config SMP_INTERFACE_MPSPEC
        bool
        default n

config SMP_INTERFACE_ACPI
        bool
        default n
endif

config APIC
        def_bool y
        depends on SMP

if APIC
config MAX_NO_IOAPICS
        int 
        default "1"
        depends on APIC

config MAX_NO_IOINT
        int 
        default "24"
        depends on APIC

config MAX_NO_LINT
        int 
        default "16"
        depends on APIC

config MAX_NO_BUSES
        int
        default "16"
        depends on APIC
endif

config HPET_TIMER
        def_bool n
        depends on HPET
        
config PC_PIT_TIMER
        def_bool n
        depends on !APIC
        depends on !HPET_TIMER
endmenu

menu "Physical memory layout"

config PRTOS_LOAD_ADDR
        hex "PRTOS load address"
        default "0x49000000"

config PRTOS_OFFSET
        hex
        default "0xA0000200000"
endmenu

menu "Hypervisor arch-dependent parameters"

config PARTITION_NO_GDT_ENTRIES
        int "Number of GDTs entries per partition"
        default "32"

endmenu

config UART_TIMEOUT
       int
       default 200

source "kernel/Kconfig"
```

## core/kernel/aarch64/defconfig
```kconfig
#
# Baseline config for PRTOS Kernel on AArch64
# PRTOS version: 1.0.0
#
CONFIG_AARCH64=y
CONFIG_HWIRQ_PRIO_FBS=y
CONFIG_MMU=y
CONFIG_MAX_NO_KTHREADS=255
CONFIG_VMM_UPDATE_HYPERCALLS=y
CONFIG_NO_HWIRQS=32
CONFIG_TARGET_LITTLE_ENDIAN=y

#
# Processor
#
CONFIG_QEMU=y
CONFIG_SMP=y
CONFIG_NO_CPUS=4

#
# Physical memory layout
#
CONFIG_PRTOS_LOAD_ADDR=0x40100000
CONFIG_PRTOS_OFFSET=0xA0000100000

#
# Hypervisor arch-dependent parameters
#
CONFIG_UART_TIMEOUT=200
# CONFIG_EXPERIMENTAL is not set
```

## core/kernel/amd64/Kconfig
```kconfig
mainmenu "PRTOS Configuration"

config amd64
        def_bool y

config HWIRQ_PRIO_FBS
        def_bool y

config MMU
        def_bool y

config ARCH_MMU_BYPASS
        depends on !amd64
        def_bool n

config MAX_NO_KTHREADS
        int
        default "255"

config VMM_UPDATE_HYPERCALLS
        def_bool y

config NO_HWIRQS
        int
        default "16" if !APIC
        default "32" if APIC

config TARGET_LITTLE_ENDIAN
        def_bool y

menu "Processor"

choice
        prompt "Board"
        default QEMU

config QEMU
        bool "Qemu"
        select SMP_INTERFACE_ACPI if SMP

config VMWARE
        bool "VMWare"
        select SMP_INTERFACE_ACPI if SMP

endchoice

config CHIPSET_ICH
        bool
        default n

choice
        prompt "Clock source"
        default TSC_TIMER

config TSC_CLOCK
        bool "TSC"
        depends on !SMP
        select PC_PIT_TIMER

config PC_PIT_CLOCK
        bool "PIT"
        depends on !SMP
        select PC_PIT_TIMER

config HPET_CLOCK
        bool "HPET"
        select HPET
        select HPET_TIMER if !SMP

endchoice

config HPET
        def_bool n

config SMI_DISABLE
        bool "Disable SMI Interrupts (see Help WARNING note)"
        default n
        help
        WARNING:
        This option disables SMI Interrupts to provide deterministic RT behaviour.
        At a cost that disabling SMI may cause harm to your computer.
        Be sure *you know what you are doing* before disabling System Management Interrupts.
        default "0x8086" if VMWARE QEMU

config SMP
        bool "Symmetric multi-processing support"
        default n
        select HPET_CLOCK

config NO_CPUS
        int "Number of CPUs supported"
        default "4"
        depends on SMP

if SMP
config SMP_INTERFACE_MPSPEC
        bool
        default n

config SMP_INTERFACE_ACPI
        bool
        default n

config APIC
        bool
        depends on SMP
        default y

config MAX_NO_IOAPICS
        int "Maximum number of supported IO-Apics"
        depends on APIC
        default "1"

config MAX_NO_IOINT
        int "Maximum number of IO-Apic interrupt sources"
        depends on APIC
        default "24"

config MAX_NO_LINT
        int "Maximum number of Local interrupt sources "
        depends on APIC
        default "16"

config MAX_NO_BUSES
        int "Maximum number of SMP buses"
        depends on SMP
        default "16"

config HPET_TIMER
        bool "Use HPET timer"
        depends on SMP
        select HPET

config PC_PIT_TIMER
        def_bool n
        depends on !APIC
        depends on !HPET_TIMER

endif

endmenu

menu "Physical memory layout"

config PRTOS_LOAD_ADDR
        hex "PRTOS physical load address"
        default "0x1000000"

config PRTOS_OFFSET
        hex "PRTOS virtual base address"
        default "0xFC000000"

endmenu

menu "Hypervisor arch-dependent parameters"

config PARTITION_NO_GDT_ENTRIES
        int "Number of GDT entries per partition"
        default "32"

config UART_TIMEOUT
        int "Timeout on UART(us)"
        default "200"

config EXPERIMENTAL
        bool "Experimental flags"
        default n

config DEBUG
        bool "Debug flags"
        default y

config VERBOSE_TRAP
        bool "Verbose trap information"
        default y
        depends on DEBUG

config NO_GCC_OPT
        bool "No gcc optimizations"
        default n

config ID_STRING_LENGTH
        int "Max. identifier string length"
        default "16"

endmenu

source "kernel/Kconfig"
```

## core/kernel/riscv64/Kconfig
```kconfig
mainmenu "PRTOS Configuration"

config riscv64
        def_bool y

config HWIRQ_PRIO_FBS
        def_bool y

config MMU
        def_bool y

config ARCH_MMU_BYPASS
        depends on !riscv64
        def_bool n

config MAX_NO_KTHREADS
        int
        default "255"

config VMM_UPDATE_HYPERCALLS
        def_bool y

config NO_HWIRQS
        int
        default "32"

config TARGET_LITTLE_ENDIAN
        def_bool y

menu "Processor"

choice
        prompt "Board"
        default QEMU

config QEMU
        bool "Qemu RISC-V virt"

endchoice

endmenu

menu "Physical memory layout"

config PRTOS_LOAD_ADDR
        hex "PRTOS load address (physical)"
        default "0x84000000"

config PRTOS_OFFSET
        hex "PRTOS virtual address offset"
        default "0xFFFFFFC084000000"

endmenu

menu "Hypervisor arch-dependent parameters"

config UART_TIMEOUT
        int "UART timeout (us)"
        default "200"

endmenu

config SMP
        bool "Symmetric Multi-Processing support"
        default n

config NO_CPUS
        int "Number of CPUs (if SMP)"
        default "1"
        depends on SMP

source "kernel/Kconfig"
```

## core/kernel/riscv64/defconfig
```kconfig
#
# Baseline config for PRTOS Kernel on RISC-V 64-bit
# PRTOS version: 1.0.0
#
CONFIG_riscv64=y
CONFIG_HWIRQ_PRIO_FBS=y
CONFIG_MMU=y
CONFIG_MAX_NO_KTHREADS=255
CONFIG_VMM_UPDATE_HYPERCALLS=y
CONFIG_NO_HWIRQS=32
CONFIG_TARGET_LITTLE_ENDIAN=y

#
# Processor
#
CONFIG_QEMU=y
CONFIG_SMP=y
CONFIG_NO_CPUS=4

#
# Physical memory layout
#
CONFIG_PRTOS_LOAD_ADDR=0x84000000
CONFIG_PRTOS_OFFSET=0xFFFFFFC084000000

#
# Hypervisor arch-dependent parameters
#
CONFIG_UART_TIMEOUT=200
# CONFIG_EXPERIMENTAL is not set
CONFIG_DEBUG=y
CONFIG_VERBOSE_TRAP=y
# CONFIG_NO_GCC_OPT is not set
CONFIG_ID_STRING_LENGTH=16

#
# Hypervisor
#
CONFIG_PRTOS_MAX_IPVI=8
CONFIG_KSTACK_KB=8
CONFIG_MAX_NO_VCPUS=4
CONFIG_AUDIT_EVENTS=y
CONFIG_ARCH="riscv64"
CONFIG_KERNELVERSION="1.0.0"
CONFIG_PRTOS_VERSION=1
CONFIG_PRTOS_SUBVERSION=0
CONFIG_PRTOS_REVISION=0

#
# MMU
#

#
# PRTOS executable format (PEF)
#
CONFIG_PEF_COMPRESSION=y

#
# Drivers
#
CONFIG_DEV_UART=y
# CONFIG_DEV_VGA is not set
CONFIG_EARLY_OUTPUT=y
CONFIG_EARLY_DEV_UART=y
```

## core/kernel/x86/defconfig
```kconfig
#
# Baseline config for PRTOS Kernel
# PRTOS version: 1.0.0
#
CONFIG_x86=y
CONFIG_HWIRQ_PRIO_FBS=y
CONFIG_MMU=y
CONFIG_MAX_NO_KTHREADS=255
CONFIG_VMM_UPDATE_HYPERCALLS=y
CONFIG_NO_HWIRQS=32
CONFIG_TARGET_LITTLE_ENDIAN=y

#
# Processor
#
# CONFIG_QEMU is not set
CONFIG_VMWARE=y
# CONFIG_CHIPSET_ICH is not set
# CONFIG_TSC_CLOCK is not set
# CONFIG_PC_PIT_CLOCK is not set
CONFIG_HPET_CLOCK=y
CONFIG_HPET=y
# CONFIG_SMI_DISABLE is not set
CONFIG_SMP=y
CONFIG_NO_CPUS=4
# CONFIG_SMP_INTERFACE_MPSPEC is not set
CONFIG_SMP_INTERFACE_ACPI=y
CONFIG_APIC=y
CONFIG_MAX_NO_IOAPICS=1
CONFIG_MAX_NO_IOINT=24
CONFIG_MAX_NO_LINT=16
CONFIG_MAX_NO_BUSES=16
# CONFIG_HPET_TIMER is not set

#
# Physical memory layout
#
CONFIG_PRTOS_LOAD_ADDR=0x1000000
CONFIG_PRTOS_OFFSET=0xFC000000

#
# Hypervisor arch-dependent parameters
#
CONFIG_PARTITION_NO_GDT_ENTRIES=32
CONFIG_UART_TIMEOUT=200
# CONFIG_EXPERIMENTAL is not set
CONFIG_DEBUG=y
CONFIG_VERBOSE_TRAP=y
# CONFIG_NO_GCC_OPT is not set
CONFIG_ID_STRING_LENGTH=16

#
# Hypervisor
#
CONFIG_PRTOS_MAX_IPVI=8
CONFIG_KSTACK_KB=8
CONFIG_MAX_NO_VCPUS=4
CONFIG_AUDIT_EVENTS=y
CONFIG_ARCH="x86"
CONFIG_KERNELVERSION="1.0.0"
CONFIG_PRTOS_VERSION=1
CONFIG_PRTOS_SUBVERSION=0
CONFIG_PRTOS_REVISION=0


#
# MMU
#

#
# PRTOS executable format (PEF)
#
CONFIG_PEF_COMPRESSION=y

#
# Drivers
#
CONFIG_DEV_UART=y
CONFIG_DEV_VGA=y
CONFIG_EARLY_OUTPUT=y
CONFIG_DEV_NO_UARTS=2
CONFIG_EARLY_DEV_UART=y
# CONFIG_EARLY_DEV_VGA is not set
CONFIG_DEV_MEMBLOCK=y

#
# Objects
#
CONFIG_OBJ_HM_VERBOSE=y
CONFIG_OBJ_COMM_PORTS=y
CONFIG_OBJ_RAW_MEM=y
CONFIG_OBJ_STATUS=y
CONFIG_OBJ_STATUS_ACC=y
```

## core/objects/Kconfig
```kconfig
menu "Objects"

config OBJ_HM_VERBOSE
       bool "Verbose HM events"
       default y
       depends on DEBUG

config OBJ_COMM_PORTS
       bool "Sampling and queuing communication ports support" 
       default y

config OBJ_RAW_MEM
       bool "Raw memory (read/write) support"
       default y

config OBJ_STATUS
       bool "System status support"
       default y

config OBJ_STATUS_ACC
       bool "Enable PRTOS/partition status accounting"
       default n

#config CONSOLE_SCAPE_SYMB
#       bool "Enable partition id symbol on console write"
#       default n

endmenu
```

## user/bail/aarch64/defconfig
```kconfig
#
# Baseline config for bail
# PRTOS version: 1.0.0
#
CONFIG_ARCH="aarch64"
CONFIG_KERNELVERSION="1.0.0"
CONFIG_PRTOS_VERSION=1
CONFIG_PRTOS_SUBVERSION=0
CONFIG_PRTOS_REVISION=0
CONFIG_DEBUG=y

#
# Kernel options
#
CONFIG_STACK_KB=8
CONFIG_SIZE_PAGE_TABLE=16
```

## user/bail/common/Kconfig
```kconfig
source "../../core/Kconfig.ver"

config DEBUG
       bool "Debug"
       default n

menu "Kernel options"
config STACK_KB
       int "Stack size (KB)"
       default "8"
config SIZE_PAGE_TABLE
       int "Size of page tables (4KB*N)"
       default "16"
endmenu
```

## user/bootloaders/rsw/Kconfig
```kconfig
config STACK_SIZE
       int "Stack size (KB)"
       default "8"

config CONTAINER_AT_FIXED_ADDR
       bool "Load container at a fixed address"
       default y

source "../../../core/Kconfig.ver"
```

## user/bootloaders/rsw/aarch64/defconfig
```kconfig
#
# Baseline config for RSW
# PRTOS version: 1.0.0
#
CONFIG_STACK_SIZE=8
CONFIG_CONTAINER_AT_FIXED_ADDR=y
CONFIG_ARCH="aarch64"
CONFIG_KERNELVERSION="1.0.0"
CONFIG_PRTOS_VERSION=1
CONFIG_PRTOS_SUBVERSION=0
CONFIG_PRTOS_REVISION=0

#
# RSW memory layout
#
CONFIG_LOAD_ADDR=0x40200000
CONFIG_CONTAINER_ADDR=0x40280000
CONFIG_OUTPUT_ENABLED=y
```

## user/bootloaders/rsw/amd64/Kconfig
```kconfig
mainmenu "RSW Configuration"

source "Kconfig"

menu "RSW memory layout"

config LOAD_ADDR
       hex "Load address"
       default "0x100000"

config CONTAINER_ADDR
       hex "Container physical location address"
       default "0x180000"
       depends on CONTAINER_AT_FIXED_ADDR

endmenu

config OUTPUT_ENABLED
       bool "Enable RSW output"
       default n
```
