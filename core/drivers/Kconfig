## user/bootloaders/rsw/riscv64/defconfig
```kconfig
#
# Baseline config for RSW
# PRTOS version: 1.0.0
#
CONFIG_STACK_SIZE=8
CONFIG_CONTAINER_AT_FIXED_ADDR=y
CONFIG_ARCH="riscv64"
CONFIG_KERNELVERSION="1.0.0"
CONFIG_PRTOS_VERSION=1
CONFIG_PRTOS_SUBVERSION=0
CONFIG_PRTOS_REVISION=0

#
# RSW memory layout
#
CONFIG_LOAD_ADDR=0x80200000
CONFIG_CONTAINER_ADDR=0x80280000
CONFIG_OUTPUT_ENABLED=y
```

## user/bootloaders/rsw/x86/defconfig
```kconfig
#
# Baseline config for RSW
# PRTOS version: 1.0.0
#
CONFIG_STACK_SIZE=8
CONFIG_CONTAINER_AT_FIXED_ADDR=y
CONFIG_ARCH="x86"
CONFIG_KERNELVERSION="1.0.0"
CONFIG_PRTOS_VERSION=1
CONFIG_PRTOS_SUBVERSION=0
CONFIG_PRTOS_REVISION=0

#
# RSW memory layout
#
CONFIG_LOAD_ADDR=0x100000
CONFIG_CONTAINER_ADDR=0x180000
CONFIG_OUTPUT_ENABLED=y
```
